## boards/esp32-cyd/sdkconfig.defaults
```kconfig
# ESP32 CYD (ESP32-D0WD-V3) baseline defaults
CONFIG_IDF_TARGET="esp32"

# Console
CONFIG_ESP_CONSOLE_UART_DEFAULT=y
CONFIG_ESP_CONSOLE_UART_NUM=0
CONFIG_ESP_CONSOLE_UART_BAUDRATE=115200

# Partition table
CONFIG_PARTITION_TABLE_CUSTOM=y
CONFIG_PARTITION_TABLE_CUSTOM_FILENAME="partitions.csv"
CONFIG_PARTITION_TABLE_FILENAME="partitions.csv"

# Flash size (ESP32 CYD is commonly 4MB)
CONFIG_ESPTOOLPY_FLASHSIZE_4MB=y
```

## boards/esp32/m5stickc_plus2/sdkconfig.defaults
```kconfig
# M5StickC Plus2 (ESP32-PICO-V3-02) baseline defaults
CONFIG_IDF_TARGET="esp32"

# Console
CONFIG_ESP_CONSOLE_UART_DEFAULT=y
CONFIG_ESP_CONSOLE_UART_NUM=0
CONFIG_ESP_CONSOLE_UART_BAUDRATE=115200

# Partition table
CONFIG_PARTITION_TABLE_CUSTOM=y
CONFIG_PARTITION_TABLE_CUSTOM_FILENAME="partitions.csv"
CONFIG_PARTITION_TABLE_FILENAME="partitions.csv"

# Flash size (M5StickC Plus2: 8MB)
CONFIG_ESPTOOLPY_FLASHSIZE_8MB=y

# PSRAM (M5StickC Plus2: 2MB PSRAM)
CONFIG_ESP32_SPIRAM_SUPPORT=y
CONFIG_SPIRAM=y
CONFIG_SPIRAM_BOOT_INIT=y

# --- Debug WDT / livelock resets ---
CONFIG_ESP_SYSTEM_PANIC_PRINT_REBOOT=y
CONFIG_ESP_SYSTEM_PANIC_REBOOT_DELAY_SECONDS=2

# Task watchdog: PANIC (prints offender + backtrace)
CONFIG_ESP_TASK_WDT_PANIC=y
CONFIG_ESP_TASK_WDT_TIMEOUT_S=20

# (optional) if you want max verbosity while debugging
CONFIG_LOG_DEFAULT_LEVEL_DEBUG=y

# --- Interrupt watchdog diagnostics ---
CONFIG_ESP_INT_WDT=y
CONFIG_ESP_INT_WDT_TIMEOUT_MS=800
CONFIG_ESP_SYSTEM_PANIC_PRINT_REBOOT=y
CONFIG_ESP_SYSTEM_PANIC_REBOOT_DELAY_SECONDS=2
CONFIG_ESP_SYSTEM_PANIC_SILENT_REBOOT=n
CONFIG_ESP_SYSTEM_PANIC_GDBSTUB=n

# Print early logs (helps if crash is very early)
CONFIG_BOOTLOADER_LOG_LEVEL_INFO=y
CONFIG_LOG_DEFAULT_LEVEL_DEBUG=y
```

## sdkconfig.defaults
```kconfig
# ESP32 CYD (ESP32-D0WD-V3) baseline defaults
CONFIG_IDF_TARGET="esp32"

# Console
CONFIG_ESP_CONSOLE_UART_NUM=0
CONFIG_ESP_CONSOLE_UART_BAUDRATE=115200

# Partition table
CONFIG_PARTITION_TABLE_CUSTOM=y
CONFIG_PARTITION_TABLE_CUSTOM_FILENAME="partitions.csv"
CONFIG_PARTITION_TABLE_FILENAME="partitions.csv"

# Flash size (ESP32 CYD is commonly 4MB)
CONFIG_ESPTOOLPY_FLASHSIZE_4MB=y
# FATFS long filename support
CONFIG_FATFS_LFN_HEAP=y
CONFIG_FATFS_MAX_LFN=255
CONFIG_COMPILER_DISABLE_DEFAULT_ERRORS=y
CONFIG_TWAI_SUPPRESS_DEPRECATE_WARN=y
CONFIG_I2C_SUPPRESS_DEPRECATE_WARN=y
# CONFIG_ESP_CONSOLE_UART_DEFAULT is not set
CONFIG_ESP_CONSOLE_USB_SERIAL_JTAG=y
```
